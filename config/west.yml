## config/west.yml
```yaml
manifest:
  remotes:
    - name: zmkfirmware
      url-base: https://github.com/zmkfirmware
    - name: urob
      url-base: https://github.com/urob
    - name: zzeneg # <-- required for Raw HID module
      url-base: https://github.com/zzeneg
    - name: srwi # <-- required for KeyPeek module
      url-base: https://github.com/srwi
  projects:
    - name: zmk
      remote: zmkfirmware
      revision: v0.3
      import: app/west.yml
    - name: zmk-rgbled-widget
      url: https://github.com/caksoylar/zmk-rgbled-widget
      revision: v0.3
    #- name: zmk-adaptive-key
      #remote: urob
      #revision: main
    - name: zmk-auto-layer
      remote: urob
      revision: v0.3
    - name: zmk-raw-hid # <-- Raw HID module
      remote: zzeneg
      revision: v0.3
    - name: zmk-keypeek-layer-notifier # <-- KeyPeek module
      remote: srwi
      revision: v0.3
  self:
    path: config
```
